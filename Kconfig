## Kconfig
```kconfig
# Kconfig file for package soft_i2c
menuconfig PKG_USING_SOFT_I2C
    bool "Soft I2C driver package"
    select RT_USING_I2C
    select RT_USING_I2C_BITOPS
    default n

if PKG_USING_SOFT_I2C

    config PKG_SOFT_I2C_PATH
        string
        default "/packages/peripherals/soft_i2c"

    choice
        prompt "Version"
        default PKG_USING_SOFT_I2C_LATEST_VERSION
        help
            Select the package version

        config PKG_USING_SOFT_I2C_V101
            bool "v1.0.1"

        config PKG_USING_SOFT_I2C_LATEST_VERSION
            bool "latest"
    endchoice
          
    config PKG_SOFT_I2C_VER
       string
       default "v1.0.1"    if PKG_USING_SOFT_I2C_V101
       default "latest"    if PKG_USING_SOFT_I2C_LATEST_VERSION

    config PKG_SOFTI2C_USING_KCONFIG
        bool "Setup soft I2C in menuconfig"
        default n

    if PKG_SOFTI2C_USING_KCONFIG

        config PKG_SOFTI2C_BUS_NAME
            string "Soft I2C bus name"
            default "i2c10"

        config PKG_SOFTI2C_BAUDRATE
            int "Baudrate (Hz)"
            default 100000

        config PKG_SOFTI2C_SCL_GPIO
            int "GPIO port number for the SCL pin"
            help
                The scl pin is (pin number) of pin in the (port number) of GPIO port
        config PKG_SOFTI2C_SCL_PIN
            int "GPIO pin number for the scl pin"
                help
                    The scl pin is (pin number) of pin in the (port number) of GPIO port

        config PKG_SOFTI2C_SDA_GPIO
            int "GPIO port number for the SDA pin"
            help
                The sda pin is (pin number) of pin in the (port number) of GPIO port
        config PKG_SOFTI2C_SDA_PIN
            int "GPIO pin number for the sda pin"
                help
                    The sda pin is (pin number) of pin in the (port number) of GPIO port
        
        config PKG_SOFTI2C_USE_HW_US_DELAY
            bool "Use rt_hw_us_delay function"
            default n
                help
                    Select this if the project had provided the implementation of rt_hw_us_delay, or else the max baudrate the soft i2c can reach is 500Hz if RT_TICK_PER_SECOND is 1000
    endif

endif
```
